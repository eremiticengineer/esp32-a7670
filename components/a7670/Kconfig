## components/a7670/Kconfig
```kconfig
menu "A7670 Configuration"

config LTE_NETWORK_APN
    string "The network provider APN"
    default ""
    help
      Enter the network provider APN

config LTE_NETWORK_USER
    string "The network provider USER"
    default ""
    help
      Enter the network provider USER

config LTE_NETWORK_PASSWORD
    string "The network provider PASSWORD"
    default ""
    help
      Enter the network provider PASSWORD

config PHONE_NUMBER_FOR_RESPONSE
    string "The phone number to send responses to"
    default ""
    help
      Enter the phone number to send responses to

endmenu
```

## main/Kconfig
```kconfig
menu "A7670 Configuration"

config SENSOR_SEND_WEB_SERVER_HTTPS_IMAGE_UPLOAD_URL
    string "The full HTTPS POST url on the web server hosting the image upload"
    default "https://server.com/upload.php"
    help
      Enter the full HTTPS POST url on the web server hosting the image upload

config SENSOR_SEND_WEB_SERVER_HTTPS_IMAGE_UPLOAD_API_KEY
    string "The api key for the image upload"
    default ""
    help
      Enter the api key for the image upload

config SENSOR_SEND_OTA_URL
    string "The url of the ota information file"
    default "https://server.com/ota.json"
    help
      Enter the url of the ota information file

endmenu
```
